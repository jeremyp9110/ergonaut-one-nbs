## config/west.yml
```yaml
manifest:
  remotes:
    - name: zmkfirmware
      url-base: https://github.com/zmkfirmware
    - name: ergonautkb
      url-base: https://github.com/ergonautkb
    - name: jeremyp9110
      url-base: https://github.com/jeremyp9110
    - name: carrefinho
      url-base: https://github.com/carrefinho
  projects:
    - name: zmk
      remote: zmkfirmware
      revision: main
      import: app/west.yml
    - name: ergonautkb-zmk-module
      remote: ergonautkb
      revision: main
    - prospector-zmk-module
      remote: carrefinho
      revision: feat/new-status-screens
  self:
    path: .
```
